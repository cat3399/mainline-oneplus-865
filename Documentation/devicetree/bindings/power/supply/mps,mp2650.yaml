## Documentation/devicetree/bindings/power/supply/mps,mp2650.yaml
```yaml
# SPDX-License-Identifier: (GPL-2.0-only OR BSD-2-Clause)
%YAML 1.2
---
$id: http://devicetree.org/schemas/power/supply/mps,mp2650.yaml#
$schema: http://devicetree.org/meta-schemas/core.yaml#

title: Monolithic Power Systems MP2650 battery charger

maintainers:
  - Mainline OnePlus 8T community <linux-msm@vger.kernel.org>

description: |
  The MP2650 is a multi-cell switching battery charger with programmable input
  and charging current limits and ADC channels for input telemetry.

allOf:
  - $ref: power-supply.yaml#

properties:
  compatible:
    const: mps,mp2650

  reg:
    maxItems: 1

  power-supplies:
    description: Phandle to the USB Type-C or other input power supply.

  mps,battery-power-supply:
    $ref: /schemas/types.yaml#/definitions/phandle
    description: Phandle to the battery fuel gauge used for safety monitoring.

  input-current-limit-microamp:
    description: Maximum input current the board is allowed to request.
    minimum: 500000
    maximum: 3000000

  constant-charge-current-max-microamp:
    description: Maximum battery charging current allowed by the board.
    minimum: 100000
    maximum: 3000000

  mps,enable-charge-control:
    description: |
      Allow the driver to program charging limits at probe time. If absent, the
      device is only monitored until the enable_control module parameter is set.
    type: boolean

required:
  - compatible
  - reg
  - power-supplies
  - mps,battery-power-supply

additionalProperties: false

examples:
  - |
    i2c {
        #address-cells = <1>;
        #size-cells = <0>;

        charger@5c {
            compatible = "mps,mp2650";
            reg = <0x5c>;
            power-supplies = <&usb_typec>;
            mps,battery-power-supply = <&fuel_gauge>;
            input-current-limit-microamp = <2700000>;
            constant-charge-current-max-microamp = <2400000>;
        };
    };
```

## drivers/bus/mhi/host/Kconfig
```kconfig
# SPDX-License-Identifier: GPL-2.0
#
# MHI bus
#
# Copyright (c) 2018-2020, The Linux Foundation. All rights reserved.
#

config MHI_BUS
	tristate "Modem Host Interface (MHI) bus"
	help
	  Bus driver for MHI protocol. Modem Host Interface (MHI) is a
	  communication protocol used by the host processors to control
	  and communicate with modem devices over a high speed peripheral
	  bus or shared memory.

config MHI_BUS_DEBUG
	bool "Debugfs support for the MHI bus"
	depends on MHI_BUS && DEBUG_FS
	help
	  Enable debugfs support for use with the MHI transport. Allows
	  reading and/or modifying some values within the MHI controller
	  for debug and test purposes.

config MHI_BUS_PCI_GENERIC
	tristate "MHI PCI controller driver"
	depends on MHI_BUS
	depends on PCI
	help
	  This driver provides MHI PCI controller driver for devices such as
	  Qualcomm SDX55 based PCIe modems.

config MHI_BUS_SAHARA_MODEM
	tristate "MHI Sahara modem firmware loader"
	depends on MHI_BUS
	help
	  Driver that implements the Sahara v2 firmware transfer protocol
	  over MHI channels 2/3.  Required for Qualcomm Fusion modems
	  (e.g. SDX55 on Xiaomi Mi 10T / Apollo) that have no onboard
	  flash and load AMSS via Sahara after SBL EE.

config MHI_BUS_BL_LOGGER
	tristate "MHI boot logger client"
	depends on MHI_BUS
	default y if MHI_BUS_PCI_GENERIC
	help
	  Driver that drains the SBL boot-logger channel exposed by some
	  Qualcomm PCIe modems. This is used by vendor SDX55 fusion setups
	  alongside SAHARA during early boot.

config MHI_BUS_CHAN_KEEPALIVE
	tristate "MHI control-channel keep-alive (SDX55 Fusion)"
	depends on MHI_BUS
	default y if MHI_BUS_PCI_GENERIC
	help
	  Open and keep alive the EFS/QMI1/IP_CTRL MHI channels exposed by
	  the SDX55 Fusion AMSS execution environment.  Vendor kernels open
	  these via DT-defined client mappings; mainline declares them in
	  the controller config but no in-tree client binds, so the channels
	  are never STARTed.  Used as a hypothesis test for whether channel
	  completeness affects post-MISSION modem stability on Apollo.
```
